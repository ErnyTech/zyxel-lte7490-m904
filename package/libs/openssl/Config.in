## package/libs/openssl/Config.in
```kconfig
if PACKAGE_libopenssl

comment "Build Options"

choice
	prompt "Openssl Version"
	default OPENSSL_VERSION_1_1_1t
	help
		Select OpenSSL version.

	config OPENSSL_VERSION_1_0_2n
		depends on PACKAGE_libopenssl
		bool "Openssl 1.0.2n"
		
	config OPENSSL_VERSION_1_0_2o
		depends on PACKAGE_libopenssl
		bool "Openssl 1.0.2o"		

	config OPENSSL_VERSION_1_1_1b
		depends on PACKAGE_libopenssl
		bool "Openssl 1.1.1b"

	config OPENSSL_VERSION_1_1_1n
		depends on PACKAGE_libopenssl
		bool "Openssl 1.1.1n"

	config OPENSSL_VERSION_1_1_1t
		depends on PACKAGE_libopenssl
		bool "Openssl 1.1.1t"
endchoice

config OPENSSL_VERSION
	string
	default "1.0.2n"       if OPENSSL_VERSION_1_0_2n
	default "1.0.2o"       if OPENSSL_VERSION_1_0_2o	
	default "1.1.1b"       if OPENSSL_VERSION_1_1_1b
	default "1.1.1n"       if OPENSSL_VERSION_1_1_1n
	default "1.1.1t"       if OPENSSL_VERSION_1_1_1t

if OPENSSL_VERSION_1_0_2n
source "package/libs/openssl/Config-1.0.2n.in"
endif

if OPENSSL_VERSION_1_0_2o
source "package/libs/openssl/Config-1.0.2o.in"
endif

if OPENSSL_VERSION_1_1_1b
source "package/libs/openssl/Config-1.1.1b.in"
endif

if OPENSSL_VERSION_1_1_1n
source "package/libs/openssl/Config-1.1.1n.in"
endif

if OPENSSL_VERSION_1_1_1t
source "package/libs/openssl/Config-1.1.1t.in"
endif

endif
```

## package/network/services/dnsmasq/Config.in
```kconfig
config dnsmasq_release
    string
    prompt "specify dnsmasq release version" if PACKAGE_dnsmasq
    default "2.67"

config dnsmasq_dnssec
    bool
    prompt "enable/disable dnsmasq dnssec" if PACKAGE_dnsmasq
    default 0

config dnsmasq_add_client_id_on_the_same_mac
    bool
    prompt "enable/disable dnsmasq client id" if PACKAGE_dnsmasq
    default 0
```
